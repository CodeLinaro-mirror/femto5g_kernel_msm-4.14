// SPDX-License-Identifier: BSD-3-Clause
/*
 * Copyright (c) Qualcomm Technologies, Inc. and/or its subsidiaries.
 */

&soc {
	cnss_pcie: qcom,cnss {
		compatible = "qcom,cnss";
		wlan-en-gpio = <&tlmm 52 0>;
		qcom,wlan-rc-num = <0>;
		qcom,wlan-ramdump-dynamic = <0x200000>;
		qcom,msm-bus,name = "msm-cnss";
		qcom,msm-bus,num-cases = <4>;
		qcom,msm-bus,num-paths = <2>;
		qcom,msm-bus,vectors-KBps =
			<45 512 0 0>, <1 512 0 0>,
			/* Upto 200 Mbps */
			<45 512 41421 655360>, <1 512 41421 655360>,
			/* Upto 400 Mbps */
			<45 512 98572 655360>, <1 512 98572 1600000>,
			/* Upto 800 Mbps */
			<45 512 207108 1146880>, <1 512 207108 3124992>;
	};
};
