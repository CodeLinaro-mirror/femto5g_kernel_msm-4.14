// SPDX-License-Identifier: BSD-3-Clause
/*
 * Copyright (c) Qualcomm Technologies, Inc. and/or its subsidiaries.
 */

/dts-v1/;

#include "sdxprairie-v2.dtsi"
#include "sdxprairie-mtp.dtsi"
#include "sdxprairie-rome.dtsi"

/ {
	model = "Qualcomm Technologies, Inc. SDXPRAIRIE MTP V2 ROME WLAN";
	compatible = "qcom,sdxprairie-mtp",
		"qcom,sdxprairie", "qcom,mtp";
	qcom,board-id = <0xD010008 0x0>;
};
